## esp/main/Kconfig.projbuild
```kconfig
menu "Discord RFID"

    config DISCORD_RFID_MISO
        int "GPIO MISO"
        default 25
        help
            ESP32 gpio on which MISO pin of MFRC522 module is connected.

    config DISCORD_RFID_MOSI
        int "GPIO MOSI"
        default 23
        help
            ESP32 gpio on which MOSI pin of MFRC522 module is connected.

    config DISCORD_RFID_SCK
        int "GPIO SCK"
        default 19
        help
            ESP32 gpio on which SCK pin of MFRC522 module is connected.

    config DISCORD_RFID_SDA
        int "GPIO SDA"
        default 22
        help
            ESP32 gpio on which SDA pin of MFRC522 module is connected.

    config DISCORD_CHANNEL_NAME
        string "Channel name"
        default "rfidx"
        help
            Name of Discord guild channel where all communications happens
    
    config DISCORD_RFID_MASTER_ROLE_NAME
        string "Master role name"
        default "RFIDM"
        help
            Name of Discord guild role which represent RFID master bot

    config DISCORD_RFID_DEVELOPMENT
        bool "Development mode"
        help
            Print statistics about heap memory etc...

endmenu
```

## esp/sdkconfig.defaults
```kconfig
CONFIG_IDF_TARGET="esp32"
CONFIG_IDF_TARGET_ESP32=y
CONFIG_ESPTOOLPY_FLASHSIZE_4MB=y
CONFIG_ESPTOOLPY_FLASHSIZE="4MB"
```
